## conf/layer.conf
```bitbake
# We have a conf and classes directory, append to BBPATH
BBPATH .= ":${LAYERDIR}"

# We have a recipes directory, add to BBFILES
BBFILES += "${LAYERDIR}/recipes*/*/*.bb ${LAYERDIR}/recipes*/*/*.bbappend"

BBFILE_COLLECTIONS += "doom-layer"
BBFILE_PATTERN_doom-layer := "^${LAYERDIR}/"
BBFILE_PRIORITY_doom-layer = "7"
LAYERSERIES_COMPAT_doom-layer = "rocko dunfell"
```
